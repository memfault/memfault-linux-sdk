## meta-memfault-example/conf/bblayers.conf.sample
```bitbake
# POKY_BBLAYERS_CONF_VERSION is increased each time build/conf/bblayers.conf
# changes incompatibly
POKY_BBLAYERS_CONF_VERSION = "2"

BBPATH = "${TOPDIR}"
BBFILES ?= ""

YOCTOROOT = "${@os.path.abspath(os.path.join("${TOPDIR}", os.pardir))}"

BBLAYERS ?= " \
    ${YOCTOROOT}/sources/memfault-linux-sdk/meta-memfault \
    ${YOCTOROOT}/sources/memfault-linux-sdk/meta-memfault-example \
    ${YOCTOROOT}/sources/meta-openembedded/meta-multimedia \
    ${YOCTOROOT}/sources/meta-openembedded/meta-networking \
    ${YOCTOROOT}/sources/meta-openembedded/meta-oe \
    ${YOCTOROOT}/sources/meta-openembedded/meta-python \
    ${YOCTOROOT}/sources/meta-swupdate \
    ${YOCTOROOT}/sources/poky/meta \
    ${YOCTOROOT}/sources/poky/meta-poky \
    ${YOCTOROOT}/sources/poky/meta-yocto-bsp \
"
```

## meta-memfault-example/conf/layer.conf
```bitbake
# We have a conf and classes directory, add to BBPATH
BBPATH .= ":${LAYERDIR}"

# We have recipes-* directories, add to BBFILES
BBFILES += "${LAYERDIR}/recipes-*/*/*.bb \
            ${LAYERDIR}/recipes-*/*/*.bbappend"

BBFILE_COLLECTIONS += "memfault-example"
BBFILE_PATTERN_memfault-example = "^${LAYERDIR}/"
BBFILE_PRIORITY_memfault-example = "6"

LAYERSERIES_COMPAT_memfault-example = "dunfell hardknott"

LAYERDEPENDS_memfault-example = "memfault"
```

## meta-memfault-example/conf/local.conf.sample
```bitbake
MACHINE ?= "qemuarm64"
include conf/machine/${MACHINE}-memfault.conf

DISTRO = "poky"
PACKAGE_CLASSES = "package_deb"
USER_CLASSES = "buildstats"
PATCHRESOLVE = "noop"

IMAGE_FSTYPES:append = " ext4.gz"

EXTRA_IMAGE_FEATURES ?= "debug-tweaks"

# Licensing
LICENSE_FLAGS_ACCEPTED = "commercial_memfaultd"

IMAGE_FSTYPES:append = " wic wic.bmap"
MACHINE_ESSENTIAL_EXTRA_RDEPENDS += "kernel-image"
do_image_wic[depends] += "mtools-native:do_populate_sysroot dosfstools-native:do_populate_sysroot virtual/bootloader:do_deploy"

# Kernel configuration
KERNEL_FEATURES:append = " cgl/features/pstore/pstore.scc cfg/debug/misc/debug-panic-oops.scc"

# systemd system manager
DISTRO_FEATURES:append = " systemd"
DISTRO_FEATURES:remove = "sysvinit"
VIRTUAL-RUNTIME_init_manager = "systemd"
DISTRO_FEATURES_BACKFILL_CONSIDERED:append = "sysvinit"
VIRTUAL-RUNTIME_initscripts = ""

# (Optional) Disable syslog - memfaultd will persist the logs when wanted
# https://docs.yoctoproject.org/dev-manual/init-manager.html?highlight=syslog#using-systemd-journald-without-a-traditional-syslog-daemon
VIRTUAL-RUNTIME_syslog = ""
VIRTUAL-RUNTIME_base-utils-syslog = ""

# Versioning env variables
MEMFAULT_BASE_URL:pn-memfaultd := "${@d.getVar('BB_ORIGENV', False).getVar('MEMFAULT_BASE_URL')}"
MEMFAULT_PROJECT_KEY:pn-memfaultd := "${@d.getVar('BB_ORIGENV', False).getVar('MEMFAULT_PROJECT_KEY')}"
MEMFAULT_SOFTWARE_TYPE:pn-memfaultd := "${@d.getVar('BB_ORIGENV', False).getVar('MEMFAULT_SOFTWARE_TYPE')}"
MEMFAULT_SOFTWARE_VERSION:pn-memfaultd := "${@d.getVar('BB_ORIGENV', False).getVar('MEMFAULT_SOFTWARE_VERSION')}"

MEMFAULT_DEVICE_ID:pn-memfault-device-info := "${@d.getVar('BB_ORIGENV', False).getVar('MEMFAULT_DEVICE_ID')}"
MEMFAULT_HARDWARE_VERSION:pn-memfault-device-info := "${@d.getVar('BB_ORIGENV', False).getVar('MEMFAULT_HARDWARE_VERSION')}"

# Used by swupdate package to populate the 09-swupdate-args.in template file:
MEMFAULT_HARDWARE_VERSION:pn-swupdate := "${@d.getVar('BB_ORIGENV', False).getVar('MEMFAULT_HARDWARE_VERSION')}"

# Used by swupdate-image to populate the sw-description.in template file:
MEMFAULT_SOFTWARE_VERSION:pn-swupdate-image := "${@d.getVar('BB_ORIGENV', False).getVar('MEMFAULT_SOFTWARE_VERSION')}"
MEMFAULT_HARDWARE_VERSION:pn-swupdate-image := "${@d.getVar('BB_ORIGENV', False).getVar('MEMFAULT_HARDWARE_VERSION')}"

IMAGE_INSTALL:append = " curl "
```

## meta-memfault-example/conf/machine/include/qemu-memfault.inc
```bitbake
WKS_FILE = "image-qemu.wks"

SOC_FAMILY = "qemuall"
include conf/machine/include/soc-family.inc

EXTRA_IMAGEDEPENDS:append = " virtual/bootloader"
PREFERRED_PROVIDER_virtual/bootloader = "u-boot"
IMAGE_BOOT_FILES = "u-boot.bin boot.scr"

# Support runqemu script
QB_DEFAULT_FSTYPE = "wic"
QB_DRIVE_TYPE = "/dev/vdb"
QB_SYSTEM_NAME = "qemu-system-arm"
QB_DEFAULT_BIOS = "u-boot.bin"

# Used to generate the swupdate update description file
OTA_PARTITION_A = "vda2"
OTA_PARTITION_B = "vda3"
```

## meta-memfault-example/conf/machine/include/rpi-memfault.inc
```bitbake
WKS_FILE = "image-raspberrypis.wks"

# https://github.com/agherzan/meta-raspberrypi/blob/master/docs/extra-build-config.md#enable-uart
ENABLE_UART = "1"
RPI_USE_U_BOOT = "1"

# Used to generate the swupdate update description file
OTA_PARTITION_A = "mmcblk0p2"
OTA_PARTITION_B = "mmcblk0p3"
```

## meta-memfault-example/files/wic/image-raspberrypis.wks
```
part /boot --source bootimg-partition --ondisk mmcblk0 --fstype=vfat --label boot --active --align 4096 --size 20

part / --source rootfs --ondisk mmcblk0 --fstype=ext4 --label root-a --align 4096 --size 256M

part --source rootfs --ondisk mmcblk0 --fstype=ext4 --label root-b --align 4096 --size 256M

part /media --fstype=ext4 --ondisk mmcblk0 --label media --align 4096 --fixed-size 448M

bootloader --ptable msdos --timeout 1
```

## meta-memfault/conf/layer.conf
```bitbake
# We have a conf and classes directory, add to BBPATH
BBPATH .= ":${LAYERDIR}"

# We have a recipes directory, add to BBFILES
BBFILES += "${LAYERDIR}/recipes-*/*/*.bb \
    ${LAYERDIR}/recipes-*/*/*.bbappend"

BBFILE_COLLECTIONS += "memfault"
BBFILE_PATTERN_memfault := "^${LAYERDIR}/"
BBFILE_PRIORITY_memfault = "6"

LAYERSERIES_COMPAT_memfault = "dunfell hardknott"

PREFERRED_VERSION_swupdate ?= "2022.05"
PREFERRED_VERSION_collectd ?= "5.12.0"
PREFERRED_VERSION_rust-bin-cross ?= "1.65.0"
PREFERRED_VERSION_cargo-bin-cross ?= "1.65.0"
PREFERRED_VERSION_fluent-bit ?= "2.0.8"

MACHINE_ESSENTIAL_EXTRA_RRECOMMENDS:append = " memfaultd "
```
